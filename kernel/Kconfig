## kernel/Kconfig
```kconfig
menu "KernelSU"

config KSU
    tristate "KernelSU function support"
    depends on EXT4_FS
    default y
    help
      Enable kernel-level root privileges on Android System.
	    Requires CONFIG_KPROBES for kernel hooking support.
	    Requires CONFIG_EXT4_FS for `ext4_unregister_sysfs`.
	    To compile as a module, choose M here: the
	    module will be called kernelsu.

config KSU_DEBUG
    bool "KernelSU debug mode"
    depends on KSU
    default n
    help
      Enable KernelSU debug mode.

config KSU_MANUAL_SU
    bool "Use manual su"
    depends on KSU
    default y
    help
      Use manual su and authorize the corresponding command line and application via prctl

config KPM
    bool "Enable SukiSU KPM"
    depends on KSU && 64BIT
    default n
    help
      Enabling this option will activate the KPM feature of SukiSU.
      This option is suitable for scenarios where you need to force KPM to be enabled.
      but it may affect system stability.
    select KALLSYMS
    select KALLSYMS_ALL

endmenu
```
